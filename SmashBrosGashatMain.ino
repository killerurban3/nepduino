#include <Wire.h>
#include <SoftwareSerial.h>
#include <DFPlayer_Mini_Mp3.h>
#include <Adafruit_NeoPixel.h>
#include <HkNfcRw.h>
#include <HkNfcA.h>
 
#define BUTTON_1_PIN 4
#define BUTTON_2_PIN 6
#define BUTTON_3_PIN 8
#define LED_PIN      9
 
#define N_LED    1
#define N_BUTTON 3
#define BT1_ON  HIGH
#define BT1_OFF LOW
#define BT2_ON  HIGH
#define BT2_OFF LOW
#define BT3_ON  LOW
#define BT3_OFF HIGH
 
const uint8_t OFF_OFF_OFF[] = {BT1_OFF, BT2_OFF, BT3_OFF};
const uint8_t ON_OFF_OFF[]  = {BT1_ON,  BT2_OFF, BT3_OFF};
const uint8_t OFF_ON_OFF[]  = {BT1_OFF, BT2_ON,  BT3_OFF};
const uint8_t OFF_OFF_ON[]  = {BT1_OFF, BT2_OFF, BT3_ON };
const uint8_t ON_ON_OFF[]   = {BT1_ON,  BT2_ON,  BT3_OFF};
const uint8_t ON_OFF_ON[]   = {BT1_ON,  BT2_OFF, BT3_ON };
const uint8_t OFF_ON_ON[]   = {BT1_OFF, BT2_ON,  BT3_ON };
const uint8_t ON_ON_ON[]    = {BT1_ON,  BT2_ON,  BT3_ON };
 
// State定義
 
// 単体遊びモード
#define STANDALONE_NAME  0
#define STANDALONE_ITEM  1
#define STANDALONE_CLEAR 2
// ドライバー連動モード
#define DRIVER_OFF       0
#define DRIVER_LEVEL_UP  1
#define DRIVER_DOUBLE_UP 2
#define DRIVER_CRITICAL_STRIKE 3
 
// Action定義
#define GASHAT_OFF       0
#define GAME_START       1
#define DOUBLE_GASHAT    2
#define GAME_TITLE       3
#define GASHAT_OUT       4
#define GASHAT_NAME      5
#define CHARACTER_SELECT 6
#define ITEM_GET         7
#define GAME_CLEAR       8  
#define DOUBLE_GASHAT_LEVEL_UP_READY  9
#define DRIVER_CLOSE_LEVEL_UP_READY  10
#define LEVEL_UP        11
#define DRIVER_CLOSE_DOUBLE_UP_READY 12
#define DOUBLE_UP       13
#define CRITICAL_STRIKE_READY        14
#define DOUBLE_GASHAT_CRITICAL_STRIKE_READY 15
#define DRIVER_CLOSE_CRITICAL_STRIKE_READY  16
#define CRITICAL_STRIKE 17
#define DOUBLE_GASHAT_CRITICAL_STRIKE 18
 
const uint32_t UID_MARIO    PROGMEM = 2733260000; // 事前に調べたamiiboのUID
const uint32_t UID_LINK     PROGMEM = 3401930000; // 事前に調べたamiiboのUID
const uint32_t UID_LIZARDON PROGMEM = 1381520000; // 事前に調べたamiiboのUID
 
const uint8_t CHARACTER_NONE     = 255;
const uint8_t CHARACTER_MARIO    =   0;
const uint8_t CHARACTER_LINK     =   1;
const uint8_t CHARACTER_LIZARDON =   2;
 
#define LED_PATTERN_OFF 0
#define LED_PATTERN_GAME_START 90
const uint8_t LED_GAME_START[][3] PROGMEM = {
  {128,128,128},{255,255,255},{224,224,224},{192,192,192},{160,160,160},{128,128,128},{ 96, 96, 96},{ 64, 64, 64},{ 32, 32, 32},{  0,  0,  0},
  {128,128,128},{255,255,255},{255,255,255},{255,255,255},{160,160,160},{128,128,128},{ 96, 96, 96},{ 64, 64, 64},{ 32, 32, 32},{  0,  0,  0},
  {  0,  0,  0},{  0,  0,  0},{  0,  0,  0},{  0,  0,  0},{  0,  0,  0},{255,255,255},{255,255,255},{255,255,255},{255,255,255},{255,255,255},
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  { 16, 16, 16},{  0,  0,  0},{  0,  0,  0},{  0,  0,  0},{  0,  0,  0},{  0,  0,  0},{  0,  0,  0},{  0,  0,  0},{  0,  0,  0},{  0,  0,  0}
};
 
#define LED_PATTERN_GASHAT_NAME 100
const uint8_t LED_GASHAT_NAME[][3] PROGMEM = {
  {255,255,255},{128,128,128},{255,255,255},{216,216,216},{176,176,176},{136,136,136},{ 96, 96, 96},{ 56, 56, 56},{ 16, 16, 16},{  0,  0,  0},
  { 48, 48, 48},{ 96, 96, 96},{144,144,144},{192,192,192},{240,240,240},{255,255,255},{255,255,255},{255,255,255},{255,255,255},{255,255,255},
  {255,255,255},{255,255,255},{255,255,255},{255,255,255},{255,255,255},{255,255,255},{255,255,255},{255,255,255},{160,160,160},{128,128,128},
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  {255,255,255},{255,255,255},{224,224,224},{192,192,192},{160,160,160},{128,128,128},{ 96, 96, 96},{ 64, 64, 64},{ 32, 32, 32},{  0,  0,  0}
};
 
#define LED_PATTERN_CHARACTER_SELECT 20
const uint8_t LED_CHARACTER_SELECT_MARIO[][3] PROGMEM = {
  {255,  0,  0},{255,  0,  0},{255,  0,  0},{255,  0,  0},{255,  0,  0},{255,  0,  0},{255,  0,  0},{255,  0,  0},{255,  0,  0},{240,  0,  0},
  {216,  0,  0},{192,  0,  0},{168,  0,  0},{144,  0,  0},{120,  0,  0},{ 96,  0,  0},{ 72,  0,  0},{ 48,  0,  0},{ 24,  0,  0},{  0,  0,  0}
};
 
const uint8_t LED_CHARACTER_SELECT_LINK[][3] PROGMEM = {
  {  0,255,  0},{  0,255,  0},{  0,255,  0},{  0,255,  0},{  0,255,  0},{  0,255,  0},{  0,255,  0},{  0,255,  0},{  0,255,  0},{  0,240,  0},
  {  0,216,  0},{  0,192,  0},{  0,168,  0},{  0,144,  0},{  0,120,  0},{  0, 96,  0},{  0, 72,  0},{  0, 48,  0},{  0, 24,  0},{  0,  0,  0}
};
 
const uint8_t LED_CHARACTER_SELECT_LIZARDON[][3] PROGMEM = {
  {255, 52,  0},{255, 52,  0},{255, 52,  0},{255, 52,  0},{255, 52,  0},{255, 52,  0},{255, 52,  0},{255, 52,  0},{255, 52,  0},{240, 50,  0},
  {216, 44,  0},{192, 38,  0},{168, 34,  0},{144, 28,  0},{120, 24,  0},{ 96, 20,  0},{ 72, 14,  0},{ 48, 10,  0},{ 24,  4,  0},{  0,  0,  0}
};
 
#define LED_PATTERN_ITEM_GET 30
const uint8_t LED_ITEM_GET_MARIO[][3] PROGMEM = {
  { 64,  0,  0},{255,  0,  0},{ 64,  0,  0},{255,  0,  0},{ 64,  0,  0},{255,  0,  0},{ 64,  0,  0},{255,  0,  0},{255,  0,  0},{255,  0,  0},
  {255,  0,  0},{255,  0,  0},{255,  0,  0},{255,  0,  0},{255,  0,  0},{255,  0,  0},{255,  0,  0},{255,  0,  0},{255,  0,  0},{240,  0,  0},
  {216,  0,  0},{192,  0,  0},{168,  0,  0},{144,  0,  0},{120,  0,  0},{ 96,  0,  0},{ 64,  0,  0},{ 48,  0,  0},{ 24,  0,  0},{  0,  0,  0}
};
 
const uint8_t LED_ITEM_GET_LINK[][3] PROGMEM = {
  {  0,255,  0},{  0, 64,  0},{  0, 64,  0},{  0,128,  0},{  0,128,  0},{  0,255,  0},{  0,255,  0},{  0,255,  0},{  0,255,  0},{  0,255,  0}, 
  {  0,255,  0},{  0,255,  0},{  0,255,  0},{  0,255,  0},{  0,255,  0},{  0,255,  0},{  0,255,  0},{  0,255,  0},{  0,255,  0},{  0,255,  0},
  {  0,216,  0},{  0,192,  0},{  0,168,  0},{  0,144,  0},{  0,120,  0},{  0, 96,  0},{  0, 72,  0},{  0, 48,  0},{  0, 24,  0},{  0,  0,  0} 
};
 
const uint8_t LED_ITEM_GET_LIZARDON[][3] PROGMEM = {
  {255, 52,  0},{ 64, 12,  0},{255, 52,  0},{ 64, 12,  0},{255, 52,  0},{ 64, 12,  0},{255, 52,  0},{255, 52,  0},{255, 52,  0},{255, 52,  0},
  {255, 52,  0},{255, 52,  0},{255, 52,  0},{255, 52,  0},{255, 52,  0},{255, 52,  0},{255, 52,  0},{255, 52,  0},{255, 52,  0},{240, 50,  0},
  {216, 44,  0},{192, 38,  0},{168, 34,  0},{144, 28,  0},{120, 24,  0},{ 96, 20,  0},{ 72, 14,  0},{ 48, 10,  0},{ 24,  4,  0},{  0,  0,  0}
};
 
#define LED_PATTERN_GAME_CLEAR 120
const uint8_t LED_GAME_CLEAR_MARIO[][3] PROGMEM = {
  {255,  0,  0},{255,  0,  0},{216,  0,  0},{168,  0,  0},{120,  0,  0},{ 72,  0,  0},{ 24,  0,  0},{  0,  0,  0},{128,  0,  0},{255,  0,  0},
  {255,  0,  0},{255,  0,  0},{255,  0,  0},{216,  0,  0},{168,  0,  0},{120,  0,  0},{ 72,  0,  0},{ 24,  0,  0},{  0,  0,  0},{  0,  0,  0},
  {  0,  0,  0},{  0,  0,  0},{ 24,  0,  0},{ 48,  0,  0},{ 72,  0,  0},{ 96,  0,  0},{120,  0,  0},{144,  0,  0},{168,  0,  0},{192,  0,  0},
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  {  0,  0,  0},{  0,  0,  0},{  0,  0,  0},{  0,  0,  0},{  0,  0,  0},{  0,  0,  0},{  0,  0,  0},{  0,  0,  0},{  0,  0,  0},{  0,  0,  0}
};
 
const uint8_t LED_GAME_CLEAR_LINK[][3] PROGMEM = {
  {  0,255,  0},{  0,255,  0},{  0,216,  0},{  0,168,  0},{  0,120,  0},{  0, 72,  0},{  0, 24,  0},{  0,  0,  0},{  0,128,  0},{  0,255,  0},
  {  0,255,  0},{  0,255,  0},{  0,255,  0},{  0,216,  0},{  0,168,  0},{  0,120,  0},{  0, 72,  0},{  0, 24,  0},{  0,  0,  0},{  0,  0,  0},
  {  0,  0,  0},{  0,  0,  0},{  0,255,  0},{  0,255,  0},{  0,255,  0},{  0,255,  0},{  0,255,  0},{  0,255,  0},{  0,255,  0},{  0,255,  0},
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  {  0,  0,  0},{  0,  0,  0},{  0,  0,  0},{  0,  0,  0},{  0,  0,  0},{  0,  0,  0},{  0,  0,  0},{  0,  0,  0},{  0,  0,  0},{  0,  0,  0}
};
 
const uint8_t LED_GAME_CLEAR_LIZARDON[][3] PROGMEM = {
  {255, 52,  0},{255, 52,  0},{216, 44,  0},{168, 34,  0},{120, 24,  0},{ 72, 14,  0},{ 24,  4,  0},{  0,  0,  0},{128, 26,  0},{255, 52,  0},
  {255, 52,  0},{255, 52,  0},{255, 52,  0},{216, 44,  0},{168, 34,  0},{120, 24,  0},{ 72, 14,  0},{ 24,  4,  0},{  0,  0,  0},{  0,  0,  0},
  {  0,  0,  0},{  0,  0,  0},{ 64, 12,  0},{ 64, 12,  0},{ 64, 12,  0},{ 64, 12,  0},{ 64, 12,  0},{ 64, 12,  0},{ 64, 12,  0},{128, 26,  0},
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  {  0,  0,  0},{  0,  0,  0},{  0,  0,  0},{  0,  0,  0},{  0,  0,  0},{  0,  0,  0},{  0,  0,  0},{  0,  0,  0},{  0,  0,  0},{  0,  0,  0}
};
 
#define LED_PATTERN_LEVEL_UP 150
const uint8_t LED_LEVEL_UP_MARIO[][3] PROGMEM = {
  {255,  0,  0},{128,  0,  0},{ 64,  0,  0},{255,  0,  0},{216,  0,  0},{176,  0,  0},{136,  0,  0},{ 96,  0,  0},{ 56,  0,  0},{ 40,  0,  0},
  { 16,  0,  0},{  0,  0,  0},{  0,  0,  0},{  0,  0,  0},{  0,  0,  0},{255,  0,  0},{255,  0,  0},{255,  0,  0},{128,  0,  0},{ 64,  0,  0},
  {  0,  0,  0},{255,  0,  0},{255,  0,  0},{255,  0,  0},{255,  0,  0},{216,  0,  0},{192,  0,  0},{168,  0,  0},{144,  0,  0},{ 72,  0,  0},
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  { 64,  0,  0},{ 64,  0,  0},{ 64,  0,  0},{ 64,  0,  0},{ 64,  0,  0},{ 64,  0,  0},{ 64,  0,  0},{ 32,  0,  0},{ 16,  0,  0},{  0,  0,  0}
};
 
const uint8_t LED_LEVEL_UP_LINK[][3] PROGMEM = {
  {  0,255,  0},{  0,128,  0},{  0, 64,  0},{  0,255,  0},{  0,216,  0},{  0,176,  0},{  0,136,  0},{  0, 96,  0},{  0, 56,  0},{  0, 40,  0},
  {  0, 16,  0},{  0,  0,  0},{  0,  0,  0},{  0,  0,  0},{  0,  0,  0},{  0,255,  0},{  0,255,  0},{  0,255,  0},{  0,128,  0},{  0, 64,  0},
  {  0,  0,  0},{  0,255,  0},{  0,255,  0},{  0,255,  0},{  0,128,  0},{  0,216,  0},{  0,192,  0},{  0,168,  0},{  0,144,  0},{  0, 72,  0},
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  {  0, 64,  0},{  0, 64,  0},{  0, 64,  0},{  0, 64,  0},{  0, 64,  0},{  0, 64,  0},{  0, 64,  0},{  0, 32,  0},{  0, 16,  0},{  0,  0,  0}
};
 
const uint8_t LED_LEVEL_UP_LIZARDON[][3] PROGMEM = {
  {255, 52,  0},{128, 26,  0},{ 64, 12,  0},{255, 52,  0},{216, 44,  0},{176, 36,  0},{136, 28,  0},{ 96, 20,  0},{ 56, 12,  0},{ 40,  8,  0},
  { 16,  4,  0},{  0,  0,  0},{  0,  0,  0},{  0,  0,  0},{  0,  0,  0},{255, 52,  0},{255, 52,  0},{255, 52,  0},{128, 26,  0},{ 64, 12,  0},
  {  0,  0,  0},{255, 52,  0},{255, 52,  0},{255, 52,  0},{255, 52,  0},{216, 44,  0},{192, 38,  0},{168, 34,  0},{144, 28,  0},{ 72, 14,  0},
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  { 64, 12,  0},{ 64, 12,  0},{ 64, 12,  0},{ 64, 12,  0},{ 64, 12,  0},{ 64, 12,  0},{ 64, 12,  0},{ 32,  6,  0},{ 16,  3,  0},{  0,  0,  0}
};
 
#define LED_PATTERN_DOUBLE_UP 150
const uint8_t LED_DOUBLE_UP_MARIO[][3] PROGMEM = {
  {255,  0,  0},{128,  0,  0},{ 64,  0,  0},{255,  0,  0},{216,  0,  0},{176,  0,  0},{136,  0,  0},{ 96,  0,  0},{ 56,  0,  0},{ 40,  0,  0},
  { 16,  0,  0},{  0,  0,  0},{  0,  0,  0},{  0,  0,  0},{  0,  0,  0},{255,  0,  0},{255,  0,  0},{255,  0,  0},{128,  0,  0},{ 64,  0,  0},
  {  0,  0,  0},{255,  0,  0},{255,  0,  0},{255,  0,  0},{255,  0,  0},{216,  0,  0},{192,  0,  0},{168,  0,  0},{144,  0,  0},{ 72,  0,  0},
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  { 64,  0,  0},{ 64,  0,  0},{ 64,  0,  0},{ 64,  0,  0},{ 64,  0,  0},{ 64,  0,  0},{ 64,  0,  0},{ 32,  0,  0},{ 16,  0,  0},{  0,  0,  0}
};
 
const uint8_t LED_DOUBLE_UP_LINK[][3] PROGMEM = {
  {  0,255,  0},{  0,128,  0},{  0, 64,  0},{  0,255,  0},{  0,216,  0},{  0,176,  0},{  0,136,  0},{  0, 96,  0},{  0, 56,  0},{  0, 40,  0},
  {  0, 16,  0},{  0,  0,  0},{  0,  0,  0},{  0,  0,  0},{  0,  0,  0},{  0,255,  0},{  0,255,  0},{  0,255,  0},{  0,128,  0},{  0, 64,  0},
  {  0,  0,  0},{  0,255,  0},{  0,255,  0},{  0,255,  0},{  0,255,  0},{  0,216,  0},{  0,192,  0},{  0,168,  0},{  0,144,  0},{  0, 72,  0},
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  {  0, 64,  0},{  0, 64,  0},{  0, 64,  0},{  0, 64,  0},{  0, 64,  0},{  0, 64,  0},{  0, 64,  0},{  0, 32,  0},{  0, 16,  0},{  0,  0,  0}
};
 
const uint8_t LED_DOUBLE_UP_LIZARDON[][3] PROGMEM = {
  {255, 52,  0},{128, 26,  0},{ 64, 12,  0},{255, 52,  0},{216, 44,  0},{176, 36,  0},{136, 28,  0},{ 96, 20,  0},{ 56, 12,  0},{ 40,  8,  0},
  { 16,  4,  0},{  0,  0,  0},{  0,  0,  0},{  0,  0,  0},{  0,  0,  0},{255, 52,  0},{255, 52,  0},{255, 52,  0},{128, 26,  0},{ 64, 12,  0},
  {  0,  0,  0},{255, 52,  0},{255, 52,  0},{255, 52,  0},{255, 52,  0},{216, 44,  0},{192, 38,  0},{168, 34,  0},{144, 28,  0},{ 72, 14,  0},
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  { 64, 12,  0},{ 64, 12,  0},{ 64, 12,  0},{ 64, 12,  0},{ 64, 12,  0},{ 64, 12,  0},{ 64, 12,  0},{ 32,  6,  0},{ 16,  3,  0},{  0,  0,  0}
};
 
#define LED_PATTERN_CRITICAL_STRIKE 200
const uint8_t LED_CRITICAL_STRIKE_MARIO[][3] PROGMEM = {
  {255,  0,  0},{128,  0,  0},{ 64,  0,  0},{255,  0,  0},{216,  0,  0},{176,  0,  0},{136,  0,  0},{ 96,  0,  0},{ 56,  0,  0},{ 40,  0,  0},
  { 16,  0,  0},{  0,  0,  0},{  0,  0,  0},{  0,  0,  0},{  0,  0,  0},{255,  0,  0},{255,  0,  0},{216,  0,  0},{192,  0,  0},{168,  0,  0},
  {144,  0,  0},{120,  0,  0},{ 96,  0,  0},{ 64,  0,  0},{ 48,  0,  0},{ 24,  0,  0},{255,  0,  0},{216,  0,  0},{192,  0,  0},{168,  0,  0},
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  { 64,  0,  0},{ 64,  0,  0},{ 64,  0,  0},{ 64,  0,  0},{ 64,  0,  0},{ 64,  0,  0},{ 64,  0,  0},{ 32,  0,  0},{ 16,  0,  0},{  0,  0,  0}
};
 
const uint8_t LED_CRITICAL_STRIKE_LINK[][3] PROGMEM = {
  {  0,255,  0},{  0,128,  0},{  0, 64,  0},{  0,255,  0},{  0,216,  0},{  0,176,  0},{  0,136,  0},{  0, 96,  0},{  0, 56,  0},{  0, 40,  0},
  {  0, 16,  0},{  0,  0,  0},{  0,  0,  0},{  0,  0,  0},{  0,  0,  0},{  0,255,  0},{  0,255,  0},{  0,216,  0},{  0,192,  0},{  0,168,  0},
  {  0,144,  0},{  0,120,  0},{  0, 96,  0},{  0, 64,  0},{  0, 48,  0},{  0, 24,  0},{  0,255,  0},{  0,216,  0},{  0,192,  0},{  0,168,  0},
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  {  0, 64,  0},{  0, 64,  0},{  0, 64,  0},{  0, 64,  0},{  0, 64,  0},{  0, 64,  0},{  0, 64,  0},{  0, 32,  0},{  0, 16,  0},{  0,  0,  0}
};
 
const uint8_t LED_CRITICAL_STRIKE_LIZARDON[][3] PROGMEM = {
  {255, 52,  0},{128, 26,  0},{ 64, 12,  0},{255, 52,  0},{216, 44,  0},{176, 36,  0},{136, 28,  0},{ 96, 20,  0},{ 56, 12,  0},{ 40,  8,  0},
  { 16,  4,  0},{  0,  0,  0},{  0,  0,  0},{  0,  0,  0},{  0,  0,  0},{255, 52,  0},{255, 52,  0},{216, 44,  0},{192, 38,  0},{168, 34,  0},
  {144, 28,  0},{120, 24,  0},{ 96, 20,  0},{ 64, 12,  0},{ 48, 10,  0},{ 24,  4,  0},{255, 52,  0},{216, 44,  0},{192, 38,  0},{168, 34,  0},
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  { 64, 12,  0},{ 64, 12,  0},{ 64, 12,  0},{ 64, 12,  0},{ 64, 12,  0},{ 64, 12,  0},{ 64, 12,  0},{ 32,  6,  0},{ 16,  3,  0},{  0,  0,  0}
};
 
/*----------楽曲リスト----------
＜共通＞
1. GAME START    ... ガシャット 電源ON
2. DOUBLE GASHAT ... ダブルガシャット
3. GAME TITLE    ... ゲーム名
4. GASHAT OUT    ... ガシャット OUT
＜デフォルト＞
5. GASHAT NAME ... ガシャット名
＜マリオ＞
6.  CHARACTER SELECT ... キャラセレクト
7.  ITEM GET         ... アイテムゲット
8.  GAME CLEAR       ... ゲームクリアー
9.  LEVEL UP READY 1 ... レベルアップ 待機（ガシャットINから）：地上BGM
10. LEVEL UP READY 2 ... レベルアップ 待機（ドライバーCLOSEから）：地上BGM
11. LEVEL UP         ... レベルアップ：ジャンプ＋コイン
12. DOUBLE UP READY  ... ダブルアップ 待機：ワールドクリアBGM
13. DOUBLE UP        ... ダブルアップ：ジャンプ＋キノコ
14. CRITICAL STRIKE READY 1 ... クリティカルストライク待機（名乗りから）：スターBGM
15. CRITICAL STRIKE READY 2 ... クリティカルストライク待機（ドライバーCLOSEから）：スターBGM
16: CRITICAL STRIKE READY 3 ... クリティカルストライク待機（単独）
17. CRITICAL STRIKE         ... クリティカルストライク
18. CRITICAL STRIKE 2       ... クリティカルストライク（名乗りから）
＜リンク＞
19. CHARACTER SELECT ... キャラセレクト
20. ITEM GET         ... アイテムゲット
21. GAME CLEAR       ... ゲームクリアー
22. LEVEL UP READY 1 ... レベルアップ 待機（ガシャットINから）：宝箱オープン
23. LEVEL UP READY 2 ... レベルアップ 待機（ドライバーCLOSEから）：宝箱オープン
24. LEVEL UP         ... レベルアップ：アイテムゲット
25. DOUBLE UP READY  ... ダブルアップ 待機：マスターソード
26. DOUBLE UP        ... ダブルアップ：ハートの器ゲット
27. CRITICAL STRIKE READY 1 ... クリティカルストライク待機（名乗りから）：メインテーマ
28. CRITICAL STRIKE READY 2 ... クリティカルストライク待機（ドライバーCLOSEから）：メインテーマ
29: CRITICAL STRIKE READY 3 ... クリティカルストライク待機（単独）：メインテーマ
30. CRITICAL STRIKE         ... クリティカルストライク
31. CRITICAL STRIKE 2       ... クリティカルストライク（名乗りから）
＜ポケモン＞
32. CHARACTER SELECT ... キャラセレクト
33. ITEM GET         ... アイテムゲット
34. GAME CLEAR       ... ゲームクリアー
35. LEVEL UP READY 1 ... レベルアップ 待機（ガシャットINから）：タイトル
36. LEVEL UP READY 2 ... レベルアップ 待機（ドライバーCLOSEから）：タイトル
37. LEVEL UP         ... レベルアップ：ヒトカゲ鳴き声＋レベルアップ効果音
38. DOUBLE UP READY  ... ダブルアップ 待機：進化BGM
39. DOUBLE UP        ... ダブルアップ：リザードン鳴き声＋進化効果音
40. CRITICAL STRIKE READY 1 ... クリティカルストライク待機（名乗りから）：オープニング
41. CRITICAL STRIKE READY 2 ... クリティカルストライク待機（ドライバーCLOSEから）：オープニング
42: CRITICAL STRIKE READY 3 ... クリティカルストライク待機（単独）：オープニング
43. CRITICAL STRIKE         ... クリティカルストライク
44. CRITICAL STRIKE 2       ... クリティカルストライク（名乗りから）
  ----------楽曲リスト----------*/
 
const uint8_t character_sounds[][13] PROGMEM = {
  { 6, 7, 8, 9,10,11,12,13,14,15,16,17,18}, // Mario
  {19,20,21,22,23,24,25,26,27,28,29,30,31}, // Link
  {32,33,34,35,36,37,38,39,40,41,42,43,44}  // Lizardon
};
 
const char character_picts[][4] PROGMEM = {
  {'b','c','d','e'}, // Mario
  {'f','g','h','i'}, // Link
  {'j','k','l','m'}  // Lizardon
};
 
SoftwareSerial mySerial(2, 3); // RX, TX
Adafruit_NeoPixel pixels = Adafruit_NeoPixel(N_LED, LED_PIN, NEO_GRB + NEO_KHZ400);
 
uint32_t last_uid    = 0;
uint32_t current_uid = 0;
uint8_t  uid[] = {0, 0, 0, 0, 0, 0, 0}; 
// NFCのRead間隔調整用
const uint8_t NFC_READABLE = 3;
uint8_t nfc_read_count = 0; 
 
uint8_t before_state[]  = {BT1_OFF, BT2_OFF, BT3_OFF};
uint8_t current_state[] = {BT1_OFF, BT2_OFF, BT3_OFF};
uint8_t current_character = CHARACTER_NONE;
uint8_t standalone_state  = STANDALONE_NAME;
uint8_t driver_state      = DRIVER_OFF;
uint8_t action = GASHAT_OFF;
uint8_t led_pattern = LED_PATTERN_OFF;
uint8_t led_count   = 0;
 
void setup() {
  pinMode(BUTTON_1_PIN, INPUT_PULLUP);
  pinMode(BUTTON_2_PIN, INPUT_PULLUP);
  pinMode(BUTTON_3_PIN, INPUT_PULLUP);
 
  Wire.begin();
 
  // NFC Reader Ready
  bool ret = HkNfcRw::open();
  while (!ret) {}
 
  // MP3 Player Ready
  mySerial.begin (9600);
  mp3_set_serial (mySerial);  //set softwareSerial for DFPlayer-mini mp3 module 
  mp3_set_volume (25);
 
  // RGB LED Ready
  pixels.begin();
  pixels.show();
 
  delay(3000);
  action = set_action(GAME_START);
}
 
boolean temp_flag = true;
void loop() {
  //////////////////// NFCの処理 ///////////////////////
  if(driver_state == DRIVER_OFF){
    if(nfc_read_count == NFC_READABLE){
      nfc_read_count = 0;
      HkNfcRw::Type type = HkNfcRw::detect(true, false, false);
      if(type == HkNfcRw::NFC_A) {
        // Type A タグが見つかったとき    
        if(HkNfcRw::getNfcId(uid)){      
          current_uid = uid[6];
          for(int i=5; i>=0; i--){
            current_uid <<= 8; current_uid |= uid[i];
          }
 
          // UIDが変わった時のみ処理
          if(last_uid != current_uid){    
            if(current_uid == UID_MARIO){
              current_character = CHARACTER_MARIO;   
            }else if(current_uid == UID_LINK){
              current_character = CHARACTER_LINK;
            }else if(current_uid == UID_LIZARDON){
              current_character = CHARACTER_LIZARDON;
            }   
 
            action = set_action(CHARACTER_SELECT);
            show_image(pgm_read_byte(&character_picts[current_character][0]));
            standalone_state = STANDALONE_ITEM;
 
            last_uid = current_uid;
          }
        }else{
          //Serial.println(F("Failed to get UID."));
        }
      } else {
        // Type A タグが見つからなかったとき
      }
    }else{
      nfc_read_count++;
    }
  }
 
  //////////////////// スイッチの処理 ///////////////////////
  current_state[0] = digitalRead(BUTTON_1_PIN);
  current_state[1] = digitalRead(BUTTON_2_PIN);
  current_state[2] = digitalRead(BUTTON_3_PIN);
 
  if(memcmp(before_state, OFF_OFF_OFF, N_BUTTON) == 0){
    if(memcmp(current_state, OFF_OFF_OFF, N_BUTTON) == 0){
      ;
    }else if(memcmp(current_state, ON_OFF_OFF, N_BUTTON) == 0){
      if(current_character != CHARACTER_NONE){
        action = set_action(DOUBLE_GASHAT_LEVEL_UP_READY);
      }
    }else if(memcmp(current_state, OFF_ON_OFF, N_BUTTON) == 0){
      if(current_character != CHARACTER_NONE){
        action = set_action(DOUBLE_GASHAT_CRITICAL_STRIKE_READY);
      }
    }else if(memcmp(current_state, OFF_OFF_ON, N_BUTTON) == 0){
      switch(standalone_state){
      case STANDALONE_NAME:
        if(current_character == CHARACTER_NONE){
          action = set_action(GASHAT_NAME);
        }else{
          action = set_action(CHARACTER_SELECT);
          standalone_state = STANDALONE_ITEM;
        }
        break;
      case STANDALONE_ITEM:
        action = set_action(ITEM_GET);
        standalone_state = STANDALONE_CLEAR;
        break;
      case STANDALONE_CLEAR:
        action = set_action(GAME_CLEAR);
        standalone_state = STANDALONE_NAME;
        break;
      default:
        ;
      }
    }else if(memcmp(current_state, ON_ON_OFF,  N_BUTTON) == 0){
      action = set_action(DOUBLE_GASHAT);  
    }else if(memcmp(current_state, ON_OFF_ON,  N_BUTTON) == 0){
      if(current_character != CHARACTER_NONE){
        action = set_action(DOUBLE_GASHAT_LEVEL_UP_READY); 
      }
    }else if(memcmp(current_state, OFF_ON_ON,  N_BUTTON) == 0){
      if(current_character != CHARACTER_NONE){
        action = set_action(DOUBLE_GASHAT_CRITICAL_STRIKE); 
      }
    }else if(memcmp(current_state, ON_ON_ON,   N_BUTTON) == 0){
      if(current_character != CHARACTER_NONE){
        action = set_action(DOUBLE_GASHAT_CRITICAL_STRIKE_READY); 
      }
    }
  }else if(memcmp(before_state, ON_OFF_OFF, N_BUTTON) == 0){
    if(memcmp(current_state, OFF_OFF_OFF, N_BUTTON) == 0){
      action = set_action(GASHAT_OUT); 
    }else if(memcmp(current_state, ON_OFF_OFF, N_BUTTON) == 0){
      ;
    }else if(memcmp(current_state, OFF_ON_OFF, N_BUTTON) == 0){
      ;
    }else if(memcmp(current_state, OFF_OFF_ON, N_BUTTON) == 0){
      ;   
    }else if(memcmp(current_state, ON_ON_OFF,  N_BUTTON) == 0){
      if(current_character != CHARACTER_NONE){
        switch(driver_state){
        case DRIVER_OFF:
         action = set_action(LEVEL_UP);
         driver_state = DRIVER_LEVEL_UP;
         break;
        case DRIVER_LEVEL_UP:
         action = set_action(DOUBLE_UP);
         driver_state = DRIVER_DOUBLE_UP;
         break;
        case DRIVER_DOUBLE_UP:
        case DRIVER_CRITICAL_STRIKE:
         action = set_action(CRITICAL_STRIKE);
         driver_state = DRIVER_CRITICAL_STRIKE;
         break;
        default:
          ;
        }
      }      
    }else if(memcmp(current_state, ON_OFF_ON,  N_BUTTON) == 0){
      ;   
    }else if(memcmp(current_state, OFF_ON_ON,  N_BUTTON) == 0){
      ;   
    }else if(memcmp(current_state, ON_ON_ON,   N_BUTTON) == 0){
      if(current_character != CHARACTER_NONE){
        switch(driver_state){
        case DRIVER_OFF:
         action = set_action(LEVEL_UP);
         driver_state = DRIVER_LEVEL_UP;
         break;
        case DRIVER_LEVEL_UP:
         action = set_action(DOUBLE_UP);
         driver_state = DRIVER_DOUBLE_UP;
         break;
        case DRIVER_DOUBLE_UP:
        case DRIVER_CRITICAL_STRIKE:
         action = set_action(CRITICAL_STRIKE);
         driver_state = DRIVER_CRITICAL_STRIKE;
         break;
        default:
          ;
        }
      }   
    } 
  }else if(memcmp(before_state, OFF_ON_OFF, N_BUTTON) == 0){
    if(memcmp(current_state, OFF_OFF_OFF, N_BUTTON) == 0){
      action = set_action(GASHAT_OUT); 
    }else if(memcmp(current_state, ON_OFF_OFF, N_BUTTON) == 0){
      ;   
    }else if(memcmp(current_state, OFF_ON_OFF, N_BUTTON) == 0){
      ;   
    }else if(memcmp(current_state, OFF_OFF_ON, N_BUTTON) == 0){
      ;   
    }else if(memcmp(current_state, ON_ON_OFF,  N_BUTTON) == 0){
      ;
    }else if(memcmp(current_state, ON_OFF_ON,  N_BUTTON) == 0){
      ;   
    }else if(memcmp(current_state, OFF_ON_ON,  N_BUTTON) == 0){
      ;   
    }else if(memcmp(current_state, ON_ON_ON,   N_BUTTON) == 0){
      ;
    }
  }else if(memcmp(before_state, OFF_OFF_ON, N_BUTTON) == 0){
    if(memcmp(current_state, OFF_OFF_OFF, N_BUTTON) == 0){
      ;  
    }else if(memcmp(current_state, ON_OFF_OFF, N_BUTTON) == 0){
      ;   
    }else if(memcmp(current_state, OFF_ON_OFF, N_BUTTON) == 0){
      ;   
    }else if(memcmp(current_state, OFF_OFF_ON, N_BUTTON) == 0){
      ;   
    }else if(memcmp(current_state, ON_ON_OFF,  N_BUTTON) == 0){
      ;   
    }else if(memcmp(current_state, ON_OFF_ON,  N_BUTTON) == 0){
      if(current_character != CHARACTER_NONE){
        action = set_action(DOUBLE_GASHAT_LEVEL_UP_READY);
      }  
    }else if(memcmp(current_state, OFF_ON_ON,  N_BUTTON) == 0){
      if(current_character != CHARACTER_NONE){
        action = set_action(DOUBLE_GASHAT_CRITICAL_STRIKE); 
      }
    }else if(memcmp(current_state, ON_ON_ON,   N_BUTTON) == 0){
      if(current_character != CHARACTER_NONE){
        action = set_action(DOUBLE_GASHAT_CRITICAL_STRIKE_READY); 
      }
    } 
  }else if(memcmp(before_state, ON_ON_OFF,  N_BUTTON) == 0){
    if(memcmp(current_state, OFF_OFF_OFF, N_BUTTON) == 0){
      action = set_action(GASHAT_OUT);
    }else if(memcmp(current_state, ON_OFF_OFF, N_BUTTON) == 0){
      if(current_character != CHARACTER_NONE){
        switch(driver_state){
        case DRIVER_OFF:
         action = set_action(DRIVER_CLOSE_LEVEL_UP_READY);
         break;
        case DRIVER_LEVEL_UP:
         action = set_action(DRIVER_CLOSE_DOUBLE_UP_READY);
         break;
        case DRIVER_DOUBLE_UP:
        case DRIVER_CRITICAL_STRIKE:
         action = set_action(DRIVER_CLOSE_CRITICAL_STRIKE_READY);
         break;
        default:
          ;
        }
      }
    }else if(memcmp(current_state, OFF_ON_OFF, N_BUTTON) == 0){
      action = set_action(GAME_TITLE);
    }else if(memcmp(current_state, OFF_OFF_ON, N_BUTTON) == 0){
      ;   
    }else if(memcmp(current_state, ON_ON_OFF,  N_BUTTON) == 0){
      ;   
    }else if(memcmp(current_state, ON_OFF_ON,  N_BUTTON) == 0){
      ;   
    }else if(memcmp(current_state, OFF_ON_ON,  N_BUTTON) == 0){
      ;   
    }else if(memcmp(current_state, ON_ON_ON,   N_BUTTON) == 0){
      if(current_character != CHARACTER_NONE){
        action = set_action(CRITICAL_STRIKE_READY); 
      }  
    }  
  }else if(memcmp(before_state, ON_OFF_ON,  N_BUTTON) == 0){
    if(memcmp(current_state, OFF_OFF_OFF, N_BUTTON) == 0){
      action = set_action(GASHAT_OUT);  
    }else if(memcmp(current_state, ON_OFF_OFF, N_BUTTON) == 0){
      ;   
    }else if(memcmp(current_state, OFF_ON_OFF, N_BUTTON) == 0){
      ;   
    }else if(memcmp(current_state, OFF_OFF_ON, N_BUTTON) == 0){
      action = set_action(GASHAT_OUT);   
    }else if(memcmp(current_state, ON_ON_OFF,  N_BUTTON) == 0){
      ;   
    }else if(memcmp(current_state, ON_OFF_ON,  N_BUTTON) == 0){
      ;   
    }else if(memcmp(current_state, OFF_ON_ON,  N_BUTTON) == 0){
      ;   
    }else if(memcmp(current_state, ON_ON_ON,   N_BUTTON) == 0){
      if(current_character != CHARACTER_NONE){
        switch(driver_state){
        case DRIVER_OFF:
         action = set_action(LEVEL_UP);
         driver_state = DRIVER_LEVEL_UP;
         break;
        case DRIVER_LEVEL_UP:
         action = set_action(DOUBLE_UP);
         driver_state = DRIVER_DOUBLE_UP;
         break;
        case DRIVER_DOUBLE_UP:
        case DRIVER_CRITICAL_STRIKE:
         action = set_action(CRITICAL_STRIKE);
         driver_state = DRIVER_CRITICAL_STRIKE;
         break;
        default:
          ;
        }
      } 
    } 
  }else if(memcmp(before_state, OFF_ON_ON,  N_BUTTON) == 0){
    if(memcmp(current_state, OFF_OFF_OFF, N_BUTTON) == 0){
      action = set_action(GASHAT_OUT);   
    }else if(memcmp(current_state, ON_OFF_OFF, N_BUTTON) == 0){
      ;   
    }else if(memcmp(current_state, OFF_ON_OFF, N_BUTTON) == 0){
      ;   
    }else if(memcmp(current_state, OFF_OFF_ON, N_BUTTON) == 0){
      action = set_action(GASHAT_OUT);   
    }else if(memcmp(current_state, ON_ON_OFF,  N_BUTTON) == 0){
      ;   
    }else if(memcmp(current_state, ON_OFF_ON,  N_BUTTON) == 0){
      ;   
    }else if(memcmp(current_state, OFF_ON_ON,  N_BUTTON) == 0){
      ;   
    }else if(memcmp(current_state, ON_ON_ON,   N_BUTTON) == 0){
      ;
    } 
  }else if(memcmp(before_state, ON_ON_ON,   N_BUTTON) == 0){
    if(memcmp(current_state, OFF_OFF_OFF, N_BUTTON) == 0){
      action = set_action(GASHAT_OUT);  
    }else if(memcmp(current_state, ON_OFF_OFF, N_BUTTON) == 0){
      ;
    }else if(memcmp(current_state, OFF_ON_OFF, N_BUTTON) == 0){
      action = set_action(GAME_TITLE); 
    }else if(memcmp(current_state, OFF_OFF_ON, N_BUTTON) == 0){
      action = set_action(GASHAT_OUT);   
    }else if(memcmp(current_state, ON_ON_OFF,  N_BUTTON) == 0){
      ;  
    }else if(memcmp(current_state, ON_OFF_ON,  N_BUTTON) == 0){
      ; 
    }else if(memcmp(current_state, OFF_ON_ON,  N_BUTTON) == 0){
      action = set_action(GAME_TITLE);  
    }else if(memcmp(current_state, ON_ON_ON,   N_BUTTON) == 0){
      ;   
    } 
  }
 
  flash_led(action);
 
  before_state[0] = current_state[0];
  before_state[1] = current_state[1];
  before_state[2] = current_state[2];
 
  delay(100);
}
 
void show_image(char code){
  Wire.beginTransmission(8);
  Wire.write(code);
  Wire.endTransmission();
}
 
uint8_t set_action(uint8_t action){
  // 音声再生
  switch(action){
  case GASHAT_OFF:
    break;
  case GAME_START:
  case DOUBLE_GASHAT:
  case GAME_TITLE:
  case GASHAT_OUT:
  case GASHAT_NAME:
    mp3_play(action);
    break;
  default:
    uint8_t music_index = 0;
    switch(action){
    case CHARACTER_SELECT: music_index = 0; break;
    case ITEM_GET:         music_index = 1; break;
    case GAME_CLEAR:       music_index = 2; break;
    case DOUBLE_GASHAT_LEVEL_UP_READY: music_index = 3; break;
    case DRIVER_CLOSE_LEVEL_UP_READY:  music_index = 4; break;
    case LEVEL_UP:         music_index = 5; break;
    case DRIVER_CLOSE_DOUBLE_UP_READY: music_index = 6; break;
    case DOUBLE_UP:        music_index = 7; break;
    case CRITICAL_STRIKE_READY:        music_index = 8; break;
    case DOUBLE_GASHAT_CRITICAL_STRIKE_READY: music_index =  9; break;
    case DRIVER_CLOSE_CRITICAL_STRIKE_READY:  music_index = 10; break;
    case CRITICAL_STRIKE:  music_index = 11; break;
    case DOUBLE_GASHAT_CRITICAL_STRIKE: music_index = 12; break;
    default: music_index = 0;
    }
    mp3_play(pgm_read_byte(&character_sounds[current_character][music_index]));
  }
 
  // LED発光パターン変更
  switch(action){
  case GASHAT_OFF:
  case DOUBLE_GASHAT:
  case GAME_TITLE:
  case GASHAT_OUT:
  case DOUBLE_GASHAT_LEVEL_UP_READY:
  case DRIVER_CLOSE_LEVEL_UP_READY:
  case DRIVER_CLOSE_DOUBLE_UP_READY:
  case CRITICAL_STRIKE_READY:
  case DOUBLE_GASHAT_CRITICAL_STRIKE_READY:
  case DRIVER_CLOSE_CRITICAL_STRIKE_READY:
  case DOUBLE_GASHAT_CRITICAL_STRIKE:
                         led_pattern = LED_PATTERN_OFF;              break;
  case GAME_START:       led_pattern = LED_PATTERN_GAME_START;       break;
  case GASHAT_NAME:      led_pattern = LED_PATTERN_GASHAT_NAME;      break;
  case CHARACTER_SELECT: led_pattern = LED_PATTERN_CHARACTER_SELECT; break;
  case ITEM_GET:         led_pattern = LED_PATTERN_ITEM_GET;         break;
  case GAME_CLEAR:       led_pattern = LED_PATTERN_GAME_CLEAR;       break;
  case LEVEL_UP:         led_pattern = LED_PATTERN_LEVEL_UP;         break;
  case DOUBLE_UP:        led_pattern = LED_PATTERN_DOUBLE_UP;        break;
  case CRITICAL_STRIKE:  led_pattern = LED_PATTERN_CRITICAL_STRIKE;  break;
  default:               led_pattern = LED_PATTERN_OFF;
  } 
  led_count = 0;
 
  // スクリーン表示
  switch(action){
  case GASHAT_OFF:
    break;
  case GAME_START:
    show_image('a'); 
    break;
  case DOUBLE_GASHAT:
  case GAME_TITLE:
  case GASHAT_NAME:
  case CHARACTER_SELECT:
  case ITEM_GET:
  case GAME_CLEAR:
  case LEVEL_UP:
  case DOUBLE_UP:
  case CRITICAL_STRIKE:
  case DOUBLE_GASHAT_CRITICAL_STRIKE:
    break;
  default:
    uint8_t pict_index = 0;
    switch(action){
      case GASHAT_OUT: pict_index = 0; break;
      case DOUBLE_GASHAT_LEVEL_UP_READY:
      case DRIVER_CLOSE_LEVEL_UP_READY:
        show_image('z'); // LCD Reset
        delay(3000);
        pict_index = 1; break;
      case DRIVER_CLOSE_DOUBLE_UP_READY: pict_index = 2; break;
      case CRITICAL_STRIKE_READY:
      case DOUBLE_GASHAT_CRITICAL_STRIKE_READY:
      case DRIVER_CLOSE_CRITICAL_STRIKE_READY: pict_index = 3; break;
      default: pict_index = 0;
    }
    show_image(pgm_read_byte(&character_picts[current_character][pict_index]));
  }
 
  if(action == GASHAT_OUT){
    driver_state = DRIVER_OFF;     
  }
 
  return action;
}
 
void flash_led(uint8_t action){
 
  switch(action){
 
  case GAME_START:
    pixels.setPixelColor(0, pixels.Color(pgm_read_byte(&(LED_GAME_START[led_count][0])),
                                         pgm_read_byte(&(LED_GAME_START[led_count][1])),
                                         pgm_read_byte(&(LED_GAME_START[led_count][2]))));
    break;  
  case GASHAT_NAME:
    pixels.setPixelColor(0, pixels.Color(pgm_read_byte(&(LED_GASHAT_NAME[led_count][0])),
                                         pgm_read_byte(&(LED_GASHAT_NAME[led_count][1])),
                                         pgm_read_byte(&(LED_GASHAT_NAME[led_count][2]))));
    break;
  case CHARACTER_SELECT:
    switch(current_character){
      case CHARACTER_MARIO:
          pixels.setPixelColor(0, pixels.Color(pgm_read_byte(&(LED_CHARACTER_SELECT_MARIO[led_count][0])),
                                               pgm_read_byte(&(LED_CHARACTER_SELECT_MARIO[led_count][1])),
                                               pgm_read_byte(&(LED_CHARACTER_SELECT_MARIO[led_count][2]))));
          break;
      case CHARACTER_LINK:
          pixels.setPixelColor(0, pixels.Color(pgm_read_byte(&(LED_CHARACTER_SELECT_LINK[led_count][0])),
                                               pgm_read_byte(&(LED_CHARACTER_SELECT_LINK[led_count][1])),
                                               pgm_read_byte(&(LED_CHARACTER_SELECT_LINK[led_count][2]))));
          break; 
      case CHARACTER_LIZARDON:
          pixels.setPixelColor(0, pixels.Color(pgm_read_byte(&(LED_CHARACTER_SELECT_LIZARDON[led_count][0])),
                                               pgm_read_byte(&(LED_CHARACTER_SELECT_LIZARDON[led_count][1])),
                                               pgm_read_byte(&(LED_CHARACTER_SELECT_LIZARDON[led_count][2]))));
          break; 
    }
    break;
 
  case ITEM_GET:
    switch(current_character){
      case CHARACTER_MARIO:
          pixels.setPixelColor(0, pixels.Color(pgm_read_byte(&(LED_ITEM_GET_MARIO[led_count][0])),
                                               pgm_read_byte(&(LED_ITEM_GET_MARIO[led_count][1])),
                                               pgm_read_byte(&(LED_ITEM_GET_MARIO[led_count][2]))));
          break;
      case CHARACTER_LINK:
          pixels.setPixelColor(0, pixels.Color(pgm_read_byte(&(LED_ITEM_GET_LINK[led_count][0])),
                                               pgm_read_byte(&(LED_ITEM_GET_LINK[led_count][1])),
                                               pgm_read_byte(&(LED_ITEM_GET_LINK[led_count][2]))));
          break; 
      case CHARACTER_LIZARDON:
          pixels.setPixelColor(0, pixels.Color(pgm_read_byte(&(LED_ITEM_GET_LIZARDON[led_count][0])),
                                               pgm_read_byte(&(LED_ITEM_GET_LIZARDON[led_count][1])),
                                               pgm_read_byte(&(LED_ITEM_GET_LIZARDON[led_count][2]))));
          break; 
    }
    break;
 
  case GAME_CLEAR:
    switch(current_character){
      case CHARACTER_MARIO:
          pixels.setPixelColor(0, pixels.Color(pgm_read_byte(&(LED_GAME_CLEAR_MARIO[led_count][0])),
                                               pgm_read_byte(&(LED_GAME_CLEAR_MARIO[led_count][1])),
                                               pgm_read_byte(&(LED_GAME_CLEAR_MARIO[led_count][2]))));
          break;
      case CHARACTER_LINK:
          pixels.setPixelColor(0, pixels.Color(pgm_read_byte(&(LED_GAME_CLEAR_LINK[led_count][0])),
                                               pgm_read_byte(&(LED_GAME_CLEAR_LINK[led_count][1])),
                                               pgm_read_byte(&(LED_GAME_CLEAR_LINK[led_count][2]))));
          break; 
      case CHARACTER_LIZARDON:
          pixels.setPixelColor(0, pixels.Color(pgm_read_byte(&(LED_GAME_CLEAR_LIZARDON[led_count][0])),
                                               pgm_read_byte(&(LED_GAME_CLEAR_LIZARDON[led_count][1])),
                                               pgm_read_byte(&(LED_GAME_CLEAR_LIZARDON[led_count][2]))));
          break; 
    }
    break;
 
  case LEVEL_UP:
    switch(current_character){
      case CHARACTER_MARIO:
          pixels.setPixelColor(0, pixels.Color(pgm_read_byte(&(LED_LEVEL_UP_MARIO[led_count][0])),
                                               pgm_read_byte(&(LED_LEVEL_UP_MARIO[led_count][1])),
                                               pgm_read_byte(&(LED_LEVEL_UP_MARIO[led_count][2]))));
          break;
      case CHARACTER_LINK:
          pixels.setPixelColor(0, pixels.Color(pgm_read_byte(&(LED_LEVEL_UP_LINK[led_count][0])),
                                               pgm_read_byte(&(LED_LEVEL_UP_LINK[led_count][1])),
                                               pgm_read_byte(&(LED_LEVEL_UP_LINK[led_count][2]))));
          break; 
      case CHARACTER_LIZARDON:
          pixels.setPixelColor(0, pixels.Color(pgm_read_byte(&(LED_LEVEL_UP_LIZARDON[led_count][0])),
                                               pgm_read_byte(&(LED_LEVEL_UP_LIZARDON[led_count][1])),
                                               pgm_read_byte(&(LED_LEVEL_UP_LIZARDON[led_count][2]))));
          break; 
    }
    break;
 
  case DOUBLE_UP:
    switch(current_character){
      case CHARACTER_MARIO:
          pixels.setPixelColor(0, pixels.Color(pgm_read_byte(&(LED_DOUBLE_UP_MARIO[led_count][0])),
                                               pgm_read_byte(&(LED_DOUBLE_UP_MARIO[led_count][1])),
                                               pgm_read_byte(&(LED_DOUBLE_UP_MARIO[led_count][2]))));
          break;
      case CHARACTER_LINK:
          pixels.setPixelColor(0, pixels.Color(pgm_read_byte(&(LED_DOUBLE_UP_LINK[led_count][0])),
                                               pgm_read_byte(&(LED_DOUBLE_UP_LINK[led_count][1])),
                                               pgm_read_byte(&(LED_DOUBLE_UP_LINK[led_count][2]))));
          break; 
      case CHARACTER_LIZARDON:
          pixels.setPixelColor(0, pixels.Color(pgm_read_byte(&(LED_DOUBLE_UP_LIZARDON[led_count][0])),
                                               pgm_read_byte(&(LED_DOUBLE_UP_LIZARDON[led_count][1])),
                                               pgm_read_byte(&(LED_DOUBLE_UP_LIZARDON[led_count][2]))));
          break; 
    }
    break;
 
  case CRITICAL_STRIKE:
    switch(current_character){
      case CHARACTER_MARIO:
          pixels.setPixelColor(0, pixels.Color(pgm_read_byte(&(LED_CRITICAL_STRIKE_MARIO[led_count][0])),
                                               pgm_read_byte(&(LED_CRITICAL_STRIKE_MARIO[led_count][1])),
                                               pgm_read_byte(&(LED_CRITICAL_STRIKE_MARIO[led_count][2]))));
          break;
      case CHARACTER_LINK:
          pixels.setPixelColor(0, pixels.Color(pgm_read_byte(&(LED_CRITICAL_STRIKE_LINK[led_count][0])),
                                               pgm_read_byte(&(LED_CRITICAL_STRIKE_LINK[led_count][1])),
                                               pgm_read_byte(&(LED_CRITICAL_STRIKE_LINK[led_count][2]))));
          break; 
      case CHARACTER_LIZARDON:
          pixels.setPixelColor(0, pixels.Color(pgm_read_byte(&(LED_CRITICAL_STRIKE_LIZARDON[led_count][0])),
                                               pgm_read_byte(&(LED_CRITICAL_STRIKE_LIZARDON[led_count][1])),
                                               pgm_read_byte(&(LED_CRITICAL_STRIKE_LIZARDON[led_count][2]))));
          break; 
    }
    break;
 
  default:
    pixels.setPixelColor(0, pixels.Color(0,0,0));
  }
 
  if(led_count < led_pattern){
    led_count++;
  }else{
    pixels.setPixelColor(0, pixels.Color(0,0,0));
  }
 
  pixels.show();
}
